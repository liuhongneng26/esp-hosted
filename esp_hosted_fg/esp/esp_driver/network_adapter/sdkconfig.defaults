## esp_hosted_fg/esp/esp_driver/network_adapter/sdkconfig.defaults
```kconfig
# BT Configuration
CONFIG_BT_ENABLED=y
CONFIG_BT_CONTROLLER_ONLY=y

# OTA
CONFIG_ESPTOOLPY_FLASHSIZE_4MB=y
CONFIG_PARTITION_TABLE_TWO_OTA=y

# OS
CONFIG_FREERTOS_HZ=1000
CONFIG_ESP_WIFI_NVS_ENABLED=y

# Linux Host Deep Sleep allowed?
#-------------------------------
# Linux host power save is not yet supported on FG
CONFIG_HOST_DEEP_SLEEP_ALLOWED=n
CONFIG_HOST_WAKEUP_GPIO=-1

CONFIG_ESP_HOSTED_HOST_RESERVED_TCP_SRC_PORTS="22,8554,2049"
CONFIG_ESP_HOSTED_HOST_RESERVED_TCP_DEST_PORTS="22,80,443,8080,8554,554,8088"
CONFIG_ESP_HOSTED_HOST_RESERVED_UDP_DEST_PORTS="53,123,3702"
CONFIG_ESP_HOSTED_HOST_RESERVED_UDP_SRC_PORTS="3702"
```
